VERSION ""
NS_ :

BS_ :

BU_ :

BO_ 419361024 _0x18fef100: 8 Vector__XXX
 SG_ spd_veh : 8|16@1+ (0.00390625,0.0) [0.0|255.0] "Km/h" Vector__XXX
 SG_ spd_veh2 : 24|16@1+ (0.00390625,0.0) [0.0|255.0] "Km/h" Vector__XXX
BO_ 218000622 _0xCfe6cee: 8 Vector__XXX
 SG_ spd_ins : 48|16@1+ (0.00390625,0.0) [0.0|255.0] "Km/h" Vector__XXX

BA_DEF_  "BusType" STRING ;
BA_DEF_DEF_  "BusType" "";
BA_ "BusType" "CAN";
